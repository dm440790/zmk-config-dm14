## boards/shields/mykeyboard/Kconfig.defconfig
```kconfig
if SHIELD_MYKEYBOARD_LEFT

config ZMK_KEYBOARD_NAME
    default "MyKeyboard"

# The left half acts as the "central" side that connects to the host over BLE
# and combines key events from both halves. Flip this to the right side
# instead if that's how you want to pair it.
config ZMK_SPLIT_ROLE_CENTRAL
    default y

endif # SHIELD_MYKEYBOARD_LEFT

if SHIELD_MYKEYBOARD_RIGHT

config ZMK_KEYBOARD_NAME
    default "MyKeyboard"

endif # SHIELD_MYKEYBOARD_RIGHT

if SHIELD_MYKEYBOARD_LEFT || SHIELD_MYKEYBOARD_RIGHT

config ZMK_SPLIT
    default y

endif # SHIELD_MYKEYBOARD_LEFT || SHIELD_MYKEYBOARD_RIGHT
```

## boards/shields/mykeyboard/Kconfig.shield
```kconfig
config SHIELD_MYKEYBOARD_LEFT
    def_bool $(shield_is,mykeyboard_left)

config SHIELD_MYKEYBOARD_RIGHT
    def_bool $(shield_is,mykeyboard_right)
```
